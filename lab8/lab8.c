 #include <REGX52.H>
 	sbit SDA=P3^2;
	sbit STR=P3^1;
	sbit SCK=P3^0;

 void delay(int a){
   int b=0,c=0;
   for( b=0;b<a;b++){
	for(c=0;c<125;c++)
	{}
   }
 }
 unsigned char code cot[]={0x01,0x02,0x04,0x08,0x10,0x20,0x40,0x80};
  unsigned char code hang[]={0xff,0xff,0x00,0xf7,0xf7,0xf7,0x00,0xff,
							 0xff,0xff,0x00,0x76,0x76,0x76,0x76,0xff,
							 0xff,0xff,0x00,0x7f,0x7f,0x7f,0x7f,0xff,
							 0xff,0xff,0x00,0x7f,0x7f,0x7f,0x7f,0xff,
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							 0xff,0xff,0xff,0xff,0xff,0xff,0xff,0xff,
						 };
void chuyen(unsigned char x)
{
  unsigned char temp=0,i=0;
  for(i=0;i<8;i++){
   temp=x&0x80;
   if(temp==0x80) {
         SDA=1;	  }
   else { SDA=0; }
   x=x*2;
   SCK=0;
   SCK=1;
   }
  }
 void main(){
 	int i,j,k;
	while(1){
		for(i=0;i<128;i++){
		  for(j=0;j<10;j++){
		  	for(k=0;k<8;k++){
			  chuyen(hang[i+k+24]);
			  chuyen(hang[i+k+16]);
			  chuyen(hang[i+k+8]);
			  chuyen(hang[i+k]);
			  STR=0;
			  STR=1;
			  P2=cot[k];
			  delay(2);
			  P2=0x00;
			}
		  }
		}
	
	
	}
 }


		